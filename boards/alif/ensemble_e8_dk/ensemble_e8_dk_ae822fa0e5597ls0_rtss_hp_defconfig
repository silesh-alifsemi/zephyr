## boards/alif/ensemble_e8_dk/ensemble_e8_dk_ae822fa0e5597ls0_rtss_hp_defconfig
```kconfig
# Copyright (c) 2025 Alif Semiconductor
#
# SPDX-License-Identifier: Apache-2.0

# Enable MPU for memory protection
CONFIG_ARM_MPU=y

# Enable hardware stack protection
CONFIG_HW_STACK_PROTECTION=y

# Enable serial console
CONFIG_SERIAL=y
CONFIG_CONSOLE=y
CONFIG_UART_CONSOLE=y

# Enable interrupt-driven UART
CONFIG_UART_INTERRUPT_DRIVEN=y

# Use NS16550 UART driver with NS16750 variant (auto flow control)
CONFIG_UART_NS16550=y
CONFIG_UART_NS16550_VARIANT_NS16750=y
```
