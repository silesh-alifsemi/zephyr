## dts/bindings/ethernet/alif,ensemble-eth.yaml
```yaml
# SPDX-FileCopyrightText: Copyright Alif Semiconductor
# SPDX-License-Identifier: Apache-2.0

title: Alif Ensemble Ethernet MAC

description: |
  Synopsys DesignWare Ethernet QoS MAC of the Alif Ensemble SoCs, limited to
  10/100 Mbps over RMII.

  The clocks are, by name:

  - rmii-src: the RMII reference clock source selection, either the
    ETH_REFCLK pin (ALIF_ETH_RMII_REFCLK) or the internal 50 MHz PLL output
    (ALIF_ETH_RMII_PLL_50M)
  - rmii: the RMII clock gate

  The CSR clock of the MAC, which the MDIO clock is divided from, has no
  gate of its own, so the MDIO clock divider is given by snps,clk-csr.

  Example:

    eth: ethernet@48100000 {
        compatible = "alif,ensemble-eth", "snps,dwmac";
        reg = <0x48100000 0x2000>;
        clocks = <&clockctrl ALIF_ETH_RMII_REFCLK>,
                 <&clockctrl ALIF_ETH_RMII_CLK>;
        clock-names = "rmii-src", "rmii";
        phy-connection-type = "rmii";
        snps,clk-csr = <4>;
    };

compatible: "alif,ensemble-eth"

include:
  - snps,dwmac.yaml
  - pinctrl-device.yaml

properties:
  reg:
    required: true

  interrupts:
    required: true

  clocks:
    required: true

  clock-names:
    required: true

  pinctrl-0:
    required: true

  pinctrl-names:
    required: true

  snps,clk-csr:
    required: true
```
